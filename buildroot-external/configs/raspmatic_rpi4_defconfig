## buildroot-external/configs/raspmatic_rpi4_defconfig
```kconfig
BR2_aarch64=y
BR2_cortex_a72=y
BR2_ARM_FPU_VFPV4=y
BR2_DL_DIR="$(TOPDIR)/../download"
BR2_KERNEL_MIRROR="https://www.kernel.org/pub"
BR2_GNU_MIRROR="http://ftp.gnu.org/pub/gnu"
BR2_CCACHE=y
BR2_OPTIMIZE_2=y
BR2_GLOBAL_PATCH_DIR="$(BR2_EXTERNAL_EQ3_PATH)/patches"
# BR2_COMPILER_PARANOID_UNSAFE_PATH is not set
BR2_RELRO_PARTIAL=y
BR2_TOOLCHAIN_BUILDROOT_GLIBC=y
BR2_PACKAGE_HOST_LINUX_HEADERS_CUSTOM_5_10=y
BR2_PACKAGE_GLIBC_UTILS=y
BR2_TOOLCHAIN_BUILDROOT_CXX=y
BR2_ROOTFS_LIB_DIR="lib"
BR2_ROOTFS_LIB32_DIR="lib32"
BR2_TARGET_GENERIC_HOSTNAME=""
BR2_TARGET_GENERIC_ISSUE="Welcome to RaspberryMatic"
BR2_TARGET_GENERIC_PASSWD_SHA512=y
BR2_ROOTFS_DEVICE_CREATION_DYNAMIC_EUDEV=y
# BR2_ENABLE_LOCALE_PURGE is not set
BR2_TARGET_LOCALTIME="Europe/Berlin"
BR2_ROOTFS_OVERLAY="$(BR2_EXTERNAL_EQ3_PATH)/overlay/base $(BR2_EXTERNAL_EQ3_PATH)/overlay/base-raspmatic $(BR2_EXTERNAL_EQ3_PATH)/overlay/WebUI $(BR2_EXTERNAL_EQ3_PATH)/overlay/WebUI-raspmatic $(BR2_EXTERNAL_EQ3_PATH)/overlay/RFD"
BR2_ROOTFS_POST_BUILD_SCRIPT="$(BR2_EXTERNAL_EQ3_PATH)/board/rpi4/post-build.sh"
BR2_ROOTFS_POST_IMAGE_SCRIPT="$(BR2_EXTERNAL_EQ3_PATH)/board/rpi4/post-image.sh"
BR2_LINUX_KERNEL=y
BR2_LINUX_KERNEL_CUSTOM_TARBALL=y
BR2_LINUX_KERNEL_CUSTOM_TARBALL_LOCATION="https://github.com/raspberrypi/linux/archive/raspberrypi-kernel_1.20210527-1.tar.gz"
BR2_LINUX_KERNEL_PATCH="$(BR2_EXTERNAL_EQ3_PATH)/board/rpi4/kernel-patches"
BR2_LINUX_KERNEL_USE_CUSTOM_CONFIG=y
BR2_LINUX_KERNEL_CUSTOM_CONFIG_FILE="$(BR2_EXTERNAL_EQ3_PATH)/board/rpi4/kernel_defconfig"
BR2_LINUX_KERNEL_LZ4=y
BR2_LINUX_KERNEL_DTS_SUPPORT=y
BR2_LINUX_KERNEL_INTREE_DTS_NAME="broadcom/bcm2711-rpi-4-b broadcom/bcm2711-rpi-400 broadcom/bcm2711-rpi-cm4"
BR2_LINUX_KERNEL_NEEDS_HOST_OPENSSL=y
BR2_PACKAGE_LINUX_TOOLS_GPIO=y
BR2_PACKAGE_BUSYBOX_CONFIG="$(BR2_EXTERNAL_EQ3_PATH)/Busybox.config"
BR2_PACKAGE_BUSYBOX_SHOW_OTHERS=y
BR2_PACKAGE_STRACE=y
BR2_PACKAGE_JQ=y
BR2_PACKAGE_DOSFSTOOLS=y
BR2_PACKAGE_DOSFSTOOLS_FATLABEL=y
BR2_PACKAGE_DOSFSTOOLS_FSCK_FAT=y
BR2_PACKAGE_DOSFSTOOLS_MKFS_FAT=y
BR2_PACKAGE_E2FSPROGS=y
BR2_PACKAGE_E2FSPROGS_E4DEFRAG=y
BR2_PACKAGE_E2FSPROGS_RESIZE2FS=y
BR2_PACKAGE_EXFAT=y
BR2_PACKAGE_EXFAT_UTILS=y
BR2_PACKAGE_F2FS_TOOLS=y
BR2_PACKAGE_NTFS_3G=y
BR2_PACKAGE_DEJAVU=y
BR2_PACKAGE_LIBERATION=y
BR2_PACKAGE_PSPLASH=y
BR2_PACKAGE_PSPLASH_PATCH="$(BR2_EXTERNAL_EQ3_PATH)/patches/psplash/raspmatic"
BR2_PACKAGE_LINUX_FIRMWARE=y
BR2_PACKAGE_LINUX_FIRMWARE_RALINK_RT61=y
BR2_PACKAGE_LINUX_FIRMWARE_RALINK_RT73=y
BR2_PACKAGE_LINUX_FIRMWARE_RALINK_RT2XX=y
BR2_PACKAGE_LINUX_FIRMWARE_RTL_81XX=y
BR2_PACKAGE_LINUX_FIRMWARE_RTL_87XX=y
BR2_PACKAGE_LINUX_FIRMWARE_RTL_88XX=y
BR2_PACKAGE_RPI_BT_FIRMWARE=y
BR2_PACKAGE_RPI_FIRMWARE=y
BR2_PACKAGE_RPI_FIRMWARE_VERSION="1.20210527"
BR2_PACKAGE_RPI_FIRMWARE_VARIANT_PI4=y
BR2_PACKAGE_RPI_WIFI_FIRMWARE=y
BR2_PACKAGE_I2C_TOOLS=y
BR2_PACKAGE_PARTED=y
BR2_PACKAGE_RNG_TOOLS=y
BR2_PACKAGE_RPI_USERLAND=y
BR2_PACKAGE_SMARTMONTOOLS=y
BR2_PACKAGE_UBOOT_TOOLS=y
BR2_PACKAGE_UBOOT_TOOLS_MKIMAGE=y
BR2_PACKAGE_UBOOT_TOOLS_MKENVIMAGE=y
BR2_PACKAGE_UBOOT_TOOLS_DUMPIMAGE=y
BR2_PACKAGE_USB_MODESWITCH_DATA=y
BR2_PACKAGE_USBMOUNT=y
BR2_PACKAGE_NODEJS=y
BR2_PACKAGE_NODEJS_NPM=y
BR2_PACKAGE_NODEJS_MODULES_ADDITIONAL="async accepts mc charenc encodeurl inherits moment range-parser unorm adm-zip compress-commons end-of-stream ipaddr.js moment-timezone raw-body unpipe archiver concat-map escape-html is-buffer ms readable-stream url archiver-utils content-disposition etag isarray negotiator remove-trailing-separator util-deprecate array-flatten content-type express jmespath node-dir safe-buffer utils-merge async cookie finalhandler jsonfile node-localstorage sax uuid aws-sdk cookie-signature forwarded lazystream normalize-path send vary balanced-match core-util-is fresh lodash on-finished serve-static walkdir base64-js crc fs-extra loop-protect once setprototypeof winreg big-integer crc32-stream fs.realpath md5 parseurl slide wrappy bl cron glob media-typer path-is-absolute statuses write-file-atomic body-parser crypt graceful-fs merge-descriptors path-to-regexp string_decoder ws brace-expansion crypto-browserify http-errors methods process-nextick-args suncalc xml2js buffer debug iconv-lite mime proxy-addr tar-stream xmlbuilder buffer-crc32 depd ieee754 mime-db punycode type-is xtend buffer-shims destroy imurmurhash mime-types qs ultron zip-stream bytes ee-first inflight minimatch querystring universalify"
BR2_PACKAGE_CA_CERTIFICATES=y
BR2_PACKAGE_LIBOPENSSL_BIN=y
BR2_PACKAGE_FONTCONFIG=y
BR2_PACKAGE_DTC=y
BR2_PACKAGE_LIBGPIOD=y
BR2_PACKAGE_LIBGPIOD_TOOLS=y
BR2_PACKAGE_LIBUSB_COMPAT=y
BR2_PACKAGE_LIBCURL=y
BR2_PACKAGE_LIBCURL_CURL=y
BR2_PACKAGE_LIBNETFILTER_CONNTRACK=y
BR2_PACKAGE_MSMTP=y
BR2_PACKAGE_AVAHI=y
BR2_PACKAGE_BLUEZ5_UTILS=y
BR2_PACKAGE_BLUEZ5_UTILS_OBEX=y
BR2_PACKAGE_BLUEZ5_UTILS_CLIENT=y
BR2_PACKAGE_BLUEZ5_UTILS_DEPRECATED=y
BR2_PACKAGE_CHRONY=y
BR2_PACKAGE_ETHTOOL=y
BR2_PACKAGE_IFPLUGD=y
BR2_PACKAGE_IPTABLES=y
BR2_PACKAGE_IW=y
BR2_PACKAGE_LIGHTTPD=y
BR2_PACKAGE_LIGHTTPD_OPENSSL=y
BR2_PACKAGE_LIGHTTPD_ZLIB=y
BR2_PACKAGE_LIGHTTPD_PCRE=y
BR2_PACKAGE_NETSNMP=y
BR2_PACKAGE_NETSNMP_WITH_MIB_MODULES="host ucd-snmp/dlmod ucd-snmp/diskio ucd-snmp/extensible ucd-snmp/pass mibII/mta_sendmail etherlike-mib/dot3StatsTable disman/event-mib disman/event disman/schedule agentx tunnel misc/ipfwacc utilities target notification agent_mibs agent/extend"
BR2_PACKAGE_NETSNMP_WITHOUT_MIB_MODULES=""
BR2_PACKAGE_NTP=y
# BR2_PACKAGE_NTP_NTPD is not set
BR2_PACKAGE_NTP_NTPDATE=y
BR2_PACKAGE_OPENSSH=y
BR2_PACKAGE_OPENVPN=y
BR2_PACKAGE_RSYNC=y
BR2_PACKAGE_SER2NET=y
BR2_PACKAGE_SOCAT=y
BR2_PACKAGE_TCPDUMP=y
BR2_PACKAGE_WGET=y
BR2_PACKAGE_WIREGUARD_TOOLS=y
BR2_PACKAGE_WPA_SUPPLICANT=y
BR2_PACKAGE_WPA_SUPPLICANT_AP_SUPPORT=y
BR2_PACKAGE_WPA_SUPPLICANT_AUTOSCAN=y
BR2_PACKAGE_WPA_SUPPLICANT_HOTSPOT=y
BR2_PACKAGE_WPA_SUPPLICANT_DEBUG_SYSLOG=y
BR2_PACKAGE_WPA_SUPPLICANT_WPS=y
BR2_PACKAGE_WPA_SUPPLICANT_WPA3=y
BR2_PACKAGE_WPA_SUPPLICANT_CLI=y
BR2_PACKAGE_WPA_SUPPLICANT_PASSPHRASE=y
BR2_PACKAGE_WPA_SUPPLICANT_DBUS=y
BR2_PACKAGE_WPA_SUPPLICANT_DBUS_INTROSPECTION=y
BR2_PACKAGE_XINETD=y
BR2_PACKAGE_FILE=y
BR2_PACKAGE_LOGROTATE=y
BR2_PACKAGE_IRQBALANCE=y
BR2_PACKAGE_KMOD_TOOLS=y
BR2_PACKAGE_MONIT=y
BR2_PACKAGE_NUT=y
BR2_PACKAGE_TAR=y
BR2_PACKAGE_UTIL_LINUX_BINARIES=y
BR2_PACKAGE_UTIL_LINUX_LOSETUP=y
BR2_PACKAGE_UTIL_LINUX_RFKILL=y
BR2_PACKAGE_UTIL_LINUX_ZRAMCTL=y
BR2_TARGET_ROOTFS_EXT2=y
BR2_TARGET_ROOTFS_EXT2_4=y
BR2_TARGET_ROOTFS_EXT2_SIZE="1G"
BR2_TARGET_ROOTFS_EXT2_MKFS_OPTIONS=""
# BR2_TARGET_ROOTFS_TAR is not set
BR2_TARGET_UBOOT=y
BR2_TARGET_UBOOT_BUILD_SYSTEM_KCONFIG=y
BR2_TARGET_UBOOT_CUSTOM_VERSION=y
BR2_TARGET_UBOOT_CUSTOM_VERSION_VALUE="2021.04"
BR2_TARGET_UBOOT_PATCH="$(BR2_EXTERNAL_EQ3_PATH)/board/rpi4/uboot-patches"
BR2_TARGET_UBOOT_USE_CUSTOM_CONFIG=y
BR2_TARGET_UBOOT_CUSTOM_CONFIG_FILE="$(BR2_EXTERNAL_EQ3_PATH)/board/rpi4/uboot_defconfig"
BR2_TARGET_UBOOT_NEEDS_DTC=y
BR2_PACKAGE_HOST_DOSFSTOOLS=y
BR2_PACKAGE_HOST_GENIMAGE=y
BR2_PACKAGE_HOST_MTOOLS=y
BR2_PACKAGE_HOST_UBOOT_TOOLS=y
BR2_PACKAGE_HOST_UBOOT_TOOLS_BOOT_SCRIPT=y
BR2_PACKAGE_HOST_UBOOT_TOOLS_BOOT_SCRIPT_SOURCE="$(BR2_EXTERNAL_EQ3_PATH)/board/rpi4/boot.cmd"
BR2_PACKAGE_MULTILIB32=y
BR2_PACKAGE_MULTILIB32_DEFCONFIG="multilib32_arm_a72_defconfig"
BR2_PACKAGE_RECOVERY_SYSTEM=y
BR2_PACKAGE_RECOVERY_SYSTEM_CONFIG="recovery_rpi4_defconfig"
BR2_PACKAGE_OCCU=y
BR2_PACKAGE_OCCU_RF_PROTOCOL_HM_HMIP=y
BR2_PACKAGE_OCCU_WEBUI=y
BR2_PACKAGE_OCCU_WEBUI_REGAHSS_BETA=y
BR2_PACKAGE_OCCU_HMSERVER=y
BR2_PACKAGE_CLOUDMATIC=y
BR2_PACKAGE_HMLANGW=y
BR2_PACKAGE_RPI_RF_MOD=y
BR2_PACKAGE_RPI_RF_MOD_DTS=y
BR2_PACKAGE_SUSVD=y
BR2_PACKAGE_PIUSVD=y
BR2_PACKAGE_PICOD=y
BR2_PACKAGE_STROMPI2D=y
BR2_PACKAGE_PIDESKTOPD=y
BR2_PACKAGE_ARGONONED=y
BR2_PACKAGE_RPI_EEPROM=y
BR2_PACKAGE_DETECT_RADIO_MODULE=y
BR2_PACKAGE_DAEMONIZE=y
BR2_PACKAGE_SSDPD=y
BR2_PACKAGE_EQ3CONFIGD=y
BR2_PACKAGE_WIRINGPI_RPI=y
BR2_PACKAGE_NEOSERVER=y
BR2_PACKAGE_RNDADDTOENTCNT=y
BR2_PACKAGE_RASPI_FANSHIM=y
BR2_PACKAGE_JAVA_AZUL=y
BR2_PACKAGE_DFU_UTIL=n
BR2_PACKAGE_MOSQUITTO=y
BR2_PACKAGE_MOSQUITTO_BROKER=y
BR2_PACKAGE_TPM2_PKCS11=y
BR2_PACKAGE_TPM2_TOOLS=y
BR2_PACKAGE_TPM2_ABRMD=y
BR2_PACKAGE_TPM2_TOTP=y
BR2_PACKAGE_FT232R_PROG=y
BR2_PACKAGE_PERL=y
BR2_PACKAGE_PERL_MODULES=""
BR2_PACKAGE_PERL_THREADS=y
# BR2_PACKAGE_PERL_APACHE_LOGFORMAT_COMPILER is not set
# BR2_PACKAGE_PERL_APPCONFIG is not set
BR2_PACKAGE_PERL_ASTRO_SUNTIME=y
# BR2_PACKAGE_PERL_CLASS_INSPECTOR is not set
# BR2_PACKAGE_PERL_CLASS_LOAD is not set
# BR2_PACKAGE_PERL_CLASS_METHOD_MODIFIERS is not set
# BR2_PACKAGE_PERL_CLASS_STD is not set
# BR2_PACKAGE_PERL_CLASS_STD_FAST is not set
# BR2_PACKAGE_PERL_CONVERT_ASN1 is not set
# BR2_PACKAGE_PERL_COOKIE_BAKER is not set
# BR2_PACKAGE_PERL_CRYPT_BLOWFISH is not set
# BR2_PACKAGE_PERL_CRYPT_CBC is not set
# BR2_PACKAGE_PERL_CRYPT_OPENSSL_AES is not set
# BR2_PACKAGE_PERL_CRYPT_OPENSSL_RANDOM is not set
# BR2_PACKAGE_PERL_CRYPT_OPENSSL_RSA is not set
# BR2_PACKAGE_PERL_DATA_DUMP is not set
# BR2_PACKAGE_PERL_DATA_OPTLIST is not set
# BR2_PACKAGE_PERL_DATA_UUID is not set
# BR2_PACKAGE_PERL_DATE_MANIP is not set
BR2_PACKAGE_PERL_DATETIME_TINY=y
BR2_PACKAGE_PERL_DBI=y
# BR2_PACKAGE_PERL_DEVEL_CYCLE is not set
# BR2_PACKAGE_PERL_DEVEL_GLOBALDESTRUCTION is not set
# BR2_PACKAGE_PERL_DEVEL_SIZE is not set
# BR2_PACKAGE_PERL_DEVEL_STACKTRACE is not set
# BR2_PACKAGE_PERL_DEVEL_STACKTRACE_ASHTML is not set
BR2_PACKAGE_PERL_DEVICE_SERIALPORT=y
BR2_PACKAGE_PERL_DIGEST_HMAC=y
# BR2_PACKAGE_PERL_DIGEST_SHA1 is not set
# BR2_PACKAGE_PERL_DIST_CHECKCONFLICTS is not set
BR2_PACKAGE_PERL_ENCODE_LOCALE=y
BR2_PACKAGE_PERL_EXPORTER_TINY=y
BR2_PACKAGE_PERL_FILE_LISTING=y
# BR2_PACKAGE_PERL_FILE_SHAREDIR is not set
# BR2_PACKAGE_PERL_FILE_SLURP is not set
# BR2_PACKAGE_PERL_FILE_UTIL is not set
# BR2_PACKAGE_PERL_FILESYS_NOTIFY_SIMPLE is not set
# BR2_PACKAGE_PERL_GD is not set
# BR2_PACKAGE_PERL_GDGRAPH is not set
# BR2_PACKAGE_PERL_GDTEXTUTIL is not set
# BR2_PACKAGE_PERL_HASH_MULTIVALUE is not set
BR2_PACKAGE_PERL_HTML_PARSER=y
BR2_PACKAGE_PERL_HTML_TAGSET=y
BR2_PACKAGE_PERL_HTTP_COOKIES=y
# BR2_PACKAGE_PERL_HTTP_DAEMON is not set
BR2_PACKAGE_PERL_HTTP_DATE=y
# BR2_PACKAGE_PERL_HTTP_ENTITY_PARSER is not set
# BR2_PACKAGE_PERL_HTTP_HEADERS_FAST is not set
BR2_PACKAGE_PERL_HTTP_MESSAGE=y
# BR2_PACKAGE_PERL_HTTP_MULTIPARTPARSER is not set
BR2_PACKAGE_PERL_HTTP_NEGOTIATE=y
# BR2_PACKAGE_PERL_I18N is not set
BR2_PACKAGE_PERL_IO_HTML=y
BR2_PACKAGE_PERL_IO_INTERFACE=y
# BR2_PACKAGE_PERL_IO_SOCKET_MULTICAST is not set
BR2_PACKAGE_PERL_IO_SOCKET_SSL=y
# BR2_PACKAGE_PERL_JSON_MAYBEXS is not set
BR2_PACKAGE_PERL_JSON_TINY=y
BR2_PACKAGE_PERL_LIBWWW_PERL=y
# BR2_PACKAGE_PERL_LOCALE_MAKETEXT_LEXICON is not set
BR2_PACKAGE_PERL_LWP_MEDIATYPES=y
# BR2_PACKAGE_PERL_LWP_PROTOCOL_HTTPS is not set
# BR2_PACKAGE_PERL_MAIL_DKIM is not set
BR2_PACKAGE_PERL_MAILTOOLS=y
# BR2_PACKAGE_PERL_MATH_INT64 is not set
# BR2_PACKAGE_PERL_MATH_PRIME_UTIL is not set
# BR2_PACKAGE_PERL_MIME_BASE64_URLSAFE is not set
# BR2_PACKAGE_PERL_MIME_TOOLS is not set
# BR2_PACKAGE_PERL_MODULE_IMPLEMENTATION is not set
# BR2_PACKAGE_PERL_MODULE_RUNTIME is not set
# BR2_PACKAGE_PERL_MOJOLICIOUS is not set
# BR2_PACKAGE_PERL_MOJOLICIOUS_PLUGIN_AUTHENTICATION is not set
# BR2_PACKAGE_PERL_MOJOLICIOUS_PLUGIN_AUTHORIZATION is not set
# BR2_PACKAGE_PERL_MOJOLICIOUS_PLUGIN_CSPHEADER is not set
# BR2_PACKAGE_PERL_MOJOLICIOUS_PLUGIN_I18N is not set
# BR2_PACKAGE_PERL_MOJOLICIOUS_PLUGIN_SECURITYHEADER is not set
# BR2_PACKAGE_PERL_MOO is not set
BR2_PACKAGE_PERL_MOZILLA_CA=y
BR2_PACKAGE_PERL_NET_DNS=y
BR2_PACKAGE_PERL_NET_HTTP=y
BR2_PACKAGE_PERL_NET_SNMP=y
BR2_PACKAGE_PERL_NET_SSLEAY=y
BR2_PACKAGE_PERL_NET_TELNET=y
# BR2_PACKAGE_PERL_NETADDR_IP is not set
# BR2_PACKAGE_PERL_NUMBER_BYTES_HUMAN is not set
# BR2_PACKAGE_PERL_PACKAGE_STASH is not set
# BR2_PACKAGE_PERL_PARAMS_UTIL is not set
# BR2_PACKAGE_PERL_PARSE_YAPP is not set
# BR2_PACKAGE_PERL_PATH_TINY is not set
# BR2_PACKAGE_PERL_PLACK is not set
# BR2_PACKAGE_PERL_POSIX_STRFTIME_COMPILER is not set
# BR2_PACKAGE_PERL_ROLE_TINY is not set
# BR2_PACKAGE_PERL_STREAM_BUFFERED is not set
# BR2_PACKAGE_PERL_SUB_EXPORTER_PROGRESSIVE is not set
# BR2_PACKAGE_PERL_SUB_INSTALL is not set
# BR2_PACKAGE_PERL_SUB_QUOTE is not set
BR2_PACKAGE_PERL_SYS_CPU=y
BR2_PACKAGE_PERL_SYS_MEMINFO=y
BR2_PACKAGE_PERL_SYS_MMAP=y
BR2_PACKAGE_PERL_TIME_PARSEDATE=y
BR2_PACKAGE_PERL_TIMEDATE=y
BR2_PACKAGE_PERL_TRY_TINY=y
BR2_PACKAGE_PERL_TYPE_TINY=y
BR2_PACKAGE_PERL_URI=y
BR2_PACKAGE_PERL_WWW_FORM_URLENCODED=y
BR2_PACKAGE_PERL_WWW_ROBOTRULES=y
BR2_PACKAGE_PERL_X10=y
BR2_PACKAGE_PERL_XML_LIBXML=y
BR2_PACKAGE_PERL_XML_NAMESPACESUPPORT=y
BR2_PACKAGE_PERL_XML_SAX=y
BR2_PACKAGE_PERL_XML_SAX_BASE=y
# BR2_PACKAGE_PERL_NET_PING is not set
# BR2_PACKAGE_PERL_MIME_BASE64 is not set
# BR2_PACKAGE_PERL_DIGEST_MD5 is not set
# BR2_PACKAGE_PERL_DB_FILE is not set
```

## buildroot-external/package/ft232r_prog/Config.in
```kconfig
config BR2_PACKAGE_FT232R_PROG
	bool "Linux FT232R Projects and Stuff"
	select BR2_PACKAGE_LIBFTDI
	help
	  taken from http://rtr.ca/ft232r/
```
